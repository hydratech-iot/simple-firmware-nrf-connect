## Kconfig
```kconfig
#
# Copyright (c) 2018 Nordic Semiconductor
#
# SPDX-License-Identifier: LicenseRef-Nordic-5-Clause
#

source "Kconfig.zephyr"

# Copyright (c) 2019-2020 Nordic Semiconductor ASA
# SPDX-License-Identifier: Apache-2.0
```

## dts/bindings/seeed,lora-e5.yaml
```yaml
description: Seeedstudio LoRa-E5 

compatible: "seeed,lora-e5"

include: uart-device.yaml

properties:
  power-gpios:
    type: phandle-array

  reset-gpios:
    type: phandle-array

  external-reset:
    type: boolean
    description:
      Modem is reset by an external source. In most situations this will
      be the microcontroller and the ESP modem on a common reset line.

  target-speed:
    type: int
    description:
      UART baudrate which will be requested using AT commands and to which
      UART interface will be reconfigured during initialization phase. which
      UART interface will be reconfigured during initialization phase.
```

## dts/bindings/ti,tmp102.yaml
```yaml
description: |
    TMP102 Digital Temperature Sensor.  See more info at
    https://www.ti.com/product/TMP102

compatible: "ti,tmp102"

include: [sensor-device.yaml, i2c-device.yaml]

properties:
  alert-gpios:
    type: phandle-array
    description: |
      Identifies the ALERT signal, which is active-low open drain when
      produced by the sensor.
```
